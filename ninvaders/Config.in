## ninvaders/Config.in
```kconfig
config BR2_PACKAGE_NINVADERS
    bool "ninvaders"
    select BR2_PACKAGE_NCURSES
    help
        Ever wanted to play space invaders when you can't find a GUI?
        Now you can!
```
